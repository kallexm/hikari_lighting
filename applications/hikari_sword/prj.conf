## CMakeLists.txt
```
cmake_minimum_required(VERSION 3.20.0)
find_package(Zephyr REQUIRED HINTS $ENV{ZEPHYR_BASE})

project(hikari_sword_app)

target_include_directories(app PRIVATE include)

target_sources(app PRIVATE
	src/main.c
	src/hikari_light_ble.c
	src/hikari_light.c
	src/light_resource.c
	src/modes/glow.c
	src/modes/sole.c
	src/modes/off.c
	src/modes/wave.c
)

zephyr_linker_sources(SECTIONS hikari_light_mode_iterables.ld)
```

## sample.yaml
```
sample:
  name: Hikari Sword Application
  description: Lighting control for Hikari sword replica
```

## prj.conf
```kconfig
# Enable serial output over USB when correct uart is choosen in dts
CONFIG_USB_DEVICE_VID=0x2FE3
CONFIG_USB_DEVICE_PID=0x0100

CONFIG_USB_DEVICE_STACK=y
CONFIG_USB_DEVICE_PRODUCT="Hikari Light USB"
CONFIG_SERIAL=y
CONFIG_CONSOLE=y
CONFIG_UART_CONSOLE=y
CONFIG_UART_LINE_CTRL=y

# Enable Bluetooth
CONFIG_BT=y
CONFIG_BT_PERIPHERAL=y
CONFIG_BT_DEVICE_NAME_DYNAMIC=y
CONFIG_BT_DEVICE_NAME_MAX=65

# Features used by slabs
CONFIG_HEAP_MEM_POOL_SIZE=16384
CONFIG_ENTROPY_DEVICE_RANDOM_GENERATOR=y
CONFIG_FPU=y
CONFIG_GPIO=y

CONFIG_ADRLEDRGB=y

# Logging
#This hangs program for some reason
#CONFIG_LOG=y
```

## src/main.c
```c
#include <zephyr/kernel.h>
#include <zephyr/sys/printk.h>
#include <zephyr/usb/usb_device.h>
#include <zephyr/drivers/uart.h>
#include <zephyr/drivers/gpio.h>

#include "hikari_light_ble.h"
#include "light_resource.h"

#define SLEEP_TIME_MS   500

/* Debug led */
static const struct gpio_dt_spec led = GPIO_DT_SPEC_GET(DT_ALIAS(led0), gpios);

/* USB UART device */
static const struct device *usb_uart_dev = DEVICE_DT_GET(DT_CHOSEN(zephyr_console));

static void setup_debug_led(void)
{
	int ret;

	ret = device_is_ready(led.port);
	if (!ret) {
		k_oops();
	}

	ret = gpio_pin_configure_dt(&led, GPIO_OUTPUT_ACTIVE);
	if (ret < 0) {
		k_oops();
	}
}

static void wait_for_uart_attach(void)
{
	uint32_t dtr = 0;
	uint32_t timeout = 20;

	/* Poll if the DTR flag was set.
	 * Blocks in the while loop until terminal is attached.
	 */
	while (!dtr && timeout > 0) {
		uart_line_ctrl_get(usb_uart_dev, UART_LINE_CTRL_DTR, &dtr);
		// Give CPU resources to low priority threads.
		k_msleep(100);
		--timeout;
		gpio_pin_toggle_dt(&led);
	}
}

int main(void)
{
	/* Ready the red debug LED. */
	setup_debug_led();

	/* Ready USB. */
	usb_enable(NULL);

	/* Ready bluetooth. */
	ble_start();

	wait_for_uart_attach();

	printk("Starting Hikari Light Application\n");

	light_resource_init();

	gpio_pin_set_dt(&led, 0);
	while (1) {
		gpio_pin_toggle_dt(&led);
		k_msleep(SLEEP_TIME_MS);
	}

	return 0;
}
```

## include/hikari_light.h
```c
#ifndef HIKARI_LIGHT_H__
#define HIKARI_LIGHT_H__

#include <zephyr/kernel.h>

#include <stdint.h>

enum hikari_light_mode {
	HIKARI_LIGHT_MODE_GLOW = 1,
	HIKARI_LIGHT_MODE_SOLE,
	HIKARI_LIGHT_MODE_OFF,
	HIKARI_LIGHT_MODE_WAVE,
};

struct hikari_light_mode_api {
	void (*constructor)(void);
	void (*destructor)(void);
	void (*tweak_color)(float hue);
	void (*tweak_intensity)(float saturation);
	void (*tweak_gain)(float value);
	void (*tweak_speed)(float speed);
};

struct hikari_light_mode_entry {
	enum hikari_light_mode mode;
	struct hikari_light_mode_api *api;
};

#define DEFINE_HIKARI_LIGHT_MODE(name, _mode, _api) \
	static STRUCT_SECTION_ITERABLE(hikari_light_mode_entry, name) = { \
		.mode = _mode, .api = &_api \
	}

void hikari_light_mode_set(enum hikari_light_mode mode);
enum hikari_light_mode hikari_light_mode_get(void);

void hikari_light_tweak_color(float hue);
void hikari_light_tweak_intensity(float saturation);
void hikari_light_tweak_gain(float value);
void hikari_light_tweak_speed(float speed);

#endif /* HIKARI_LIGHT_H__ */
```

## include/hikari_light_ble.h
```c
#ifndef HIKARI_LIGHT_BLE_H__
#define HIKARI_LIGHT_BLE_H__

void ble_start(void);

#endif /* HIKARI_LIGHT_BLE_H__ */
```

## include/light_resource.h
```c
#ifndef LIGHT_RESOURCE_H__
#define LIGHT_RESOURCE_H__

#include <stdbool.h>
#include <stdint.h>

#include <zephyr/kernel.h>

typedef enum {
	LIGHT_RESOURCE_SUCCESS = 0,
	LIGHT_RESOURCE_NOT_FOUND = 1,
	LIGHT_RESOURCE_ALLREADY_USED = 2,
	LIGHT_RESOURCE_INSUFFICIENT_MEMORY = 3,
	LIGHT_RESOURCE_NOT_INITIALIZED = 4,
} light_res_err_t;

struct light_resource {
	sys_dnode_t root;
	char *id;
	uint8_t *data;
	size_t data_size;
	bool used;
};

void light_resource_init(void);

light_res_err_t light_resource_use(char *id, struct light_resource **res);

light_res_err_t light_resource_return(struct light_resource *res);

#endif /* LIGHT_RESOURCE_H__ */
```

## src/hikari_light.c
```c
#include <zephyr/kernel.h>

#include "hikari_light.h"

#define HIKARI_LIGHT_THREAD_STACK_SIZE 2048
#define HIKARI_LIGHT_THREAD_PRIORITY 5
#define HIKARI_LIGHT_THREAD_START_DELAY_MS 500

/*==============================[Action FIFO]=================================*/
static K_FIFO_DEFINE(action_fifo);

enum action_type {
	ACTION_TYPE_MODE_SET = 1,
	ACTION_TYPE_TWEAK_COLOR,
	ACTION_TYPE_TWEAK_INTENSITY,
	ACTION_TYPE_TWEAK_GAIN,
	ACTION_TYPE_TWEAK_SPEED
};

struct action_item {
	void *fifo_reserved;
	enum action_type type;
	union {
		enum hikari_light_mode mode;
		float hue;
		float saturation;
		float value;
		float speed;
	};
};

static void empty_action_fifo(void)
{
	struct action_item *item;

	do {
		item = k_fifo_get(&action_fifo, K_NO_WAIT);
	} while (item != NULL);
}

/*==============================[Singleton members]===========================*/
static enum hikari_light_mode mode;
static struct hikari_light_mode_api *api = NULL;

static K_SEM_DEFINE(num_threads_posting_actions, 0, K_SEM_MAX_LIMIT);
static bool accepting_new_actions = true;


/*==============================[Helper methods]==============================*/
static void post_action(enum action_type type, void *action_data)
{
	struct action_item *action = NULL;

	printk("Action posted: %d\n", type);

	/* Return if new actions are not to be accepted. */
	if (!accepting_new_actions) {
		return;
	}

	/* Count number of threads currently in the process of posting actions. */
	k_sem_give(&num_threads_posting_actions);

	/* Create and compose action. */
	action = k_malloc(sizeof(struct action_item));
	if (action == NULL) {
		k_sem_take(&num_threads_posting_actions, K_NO_WAIT);
		k_oops();
	}

	switch (type) {
	case ACTION_TYPE_MODE_SET:
		action->mode = *((enum hikari_light_mode *)action_data);
		break;

	case ACTION_TYPE_TWEAK_COLOR:
		action->hue = *((float *)action_data);
		break;

	case ACTION_TYPE_TWEAK_INTENSITY:
		action->saturation = *((float *)action_data);
		break;

	case ACTION_TYPE_TWEAK_GAIN:
		action->value = *((float *)action_data);
		break;

	case ACTION_TYPE_TWEAK_SPEED:
		action->speed = *((float *)action_data);
		break;

	default:
		/* Cleanup and silently return if action is unsupported. */
		k_free(action);
		k_sem_take(&num_threads_posting_actions, K_NO_WAIT);
		return;
	}
	action->type = type;

	printk("Add to action queue\n");

	/* Queue action. */
	k_fifo_put(&action_fifo, action);

	/* Signal that thread is done posting an action. */
	k_sem_take(&num_threads_posting_actions, K_NO_WAIT);
}

static struct hikari_light_mode_api *get_mode_api(enum hikari_light_mode mode) 
{
	STRUCT_SECTION_FOREACH(hikari_light_mode_entry, entry) {
		printk("get_mode_api entry mode: %d\n", entry->mode);

		if (entry->mode == mode) {
			return entry->api;
		}
	}

	printk("Did not find mode %d\n", mode);
	return NULL;
}

/*==============================[Process Thread]==============================*/
static void hikari_light_loop(void *p1, void *p2, void *p3);

K_THREAD_DEFINE(hikari_light_thread, HIKARI_LIGHT_THREAD_STACK_SIZE,
				hikari_light_loop, NULL, NULL, NULL,
				HIKARI_LIGHT_THREAD_PRIORITY, 0,
				HIKARI_LIGHT_THREAD_START_DELAY_MS);

static void try_switching_mode(enum hikari_light_mode new_mode)
{
	struct hikari_light_mode_api *new_api = NULL;

	if (new_mode == mode) {
		printk("Mode %d already set\n", new_mode);
		return;
	}

	/* Check if mode is implemented. */
	new_api = get_mode_api(new_mode);
	if (new_api == NULL || 
		new_api->constructor == NULL ||
		new_api->destructor == NULL) {
		/* Do not switch mode. */

		printk("Do not switch mode\n");
		return;
	}

	printk("Switching to mode %d from %d\n", new_mode, mode);

	accepting_new_actions = false;

	/* Switch mode. */
	if (api != NULL && api->destructor != NULL) {
		api->destructor();
	}

	new_api->constructor();
	mode = new_mode;
	api = new_api;

	/* Wait for all threads to finish posting actions. */
	while (k_sem_count_get(&num_threads_posting_actions)) {
		k_sleep(K_MSEC(1));
	}

	/* Drop outdated actions. */
	empty_action_fifo();

	accepting_new_actions = true;
}

static inline void hikari_light_process(struct action_item *action)
{
	if (action == NULL) {
		k_oops();
	}

	printk("Dequeueing action: %d\n", action->type);

	switch (action->type) {
	case ACTION_TYPE_MODE_SET:
		try_switching_mode(action->mode);
		break;

	case ACTION_TYPE_TWEAK_COLOR:
		if (api->tweak_color != NULL) {
			api->tweak_color(action->hue);
		}
		break;

	case ACTION_TYPE_TWEAK_INTENSITY:
		if (api->tweak_intensity != NULL) {
			api->tweak_intensity(action->saturation);
		}
		break;

	case ACTION_TYPE_TWEAK_GAIN:
		if (api->tweak_gain != NULL) {
			api->tweak_gain(action->value);
		}
		break;

	case ACTION_TYPE_TWEAK_SPEED:
		if (api->tweak_speed != NULL) {
			api->tweak_speed(action->speed);
		}
		break;

	default:
		k_oops();
		break;
	}
}

static void hikari_light_loop(void *p1, void *p2, void *p3)
{
	struct action_item *action;

	while (1) {
		action = k_fifo_get(&action_fifo, K_FOREVER);

		hikari_light_process(action);

		k_free(action);
	}
}

/*==============================[Public methods]==============================*/
void hikari_light_mode_set(enum hikari_light_mode mode)
{
	post_action(ACTION_TYPE_MODE_SET, (void *)&mode);
}

enum hikari_light_mode hikari_light_mode_get(void)
{
	return mode;
}

void hikari_light_tweak_color(float hue)
{
	post_action(ACTION_TYPE_TWEAK_COLOR, (void *)&hue);
}

void hikari_light_tweak_intensity(float saturation)
{
	post_action(ACTION_TYPE_TWEAK_INTENSITY, (void *)&saturation);
}

void hikari_light_tweak_gain(float value)
{
	post_action(ACTION_TYPE_TWEAK_GAIN, (void *)&value);
}

void hikari_light_tweak_speed(float speed)
{
	post_action(ACTION_TYPE_TWEAK_SPEED, (void *)&speed);
}

/*============================================================================*/
```

## src/hikari_light_ble.c
```c
#include <zephyr/kernel.h>

#include <zephyr/bluetooth/bluetooth.h>
#include <zephyr/bluetooth/hci.h>
#include <zephyr/bluetooth/conn.h>
#include <zephyr/bluetooth/uuid.h>
#include <zephyr/bluetooth/gatt.h>

#include "hikari_light.h"

#define RGB_SERVICE_VAL \
	BT_UUID_128_ENCODE(0xcbb84a52, 0x063d, 0x463f, 0x9a71, 0x9aac578001d8)

#define RGB_MODE_CHRC_VAL \
	BT_UUID_128_ENCODE(0xf1873813, 0xe162, 0x4cc7, 0x8f87, 0x33442611ae6e)

#define RGB_CONF_CHRC_VAL \
	BT_UUID_128_ENCODE(0xdcbed995, 0x388c, 0x413b, 0x8f40, 0x7d1ed59a75a7)

#define DETECTOR_STATE_CHRC_VAL \
	BT_UUID_128_ENCODE(0x4794fb9a, 0xe4fc, 0x497f, 0x9e51, 0x85b92b57e4e3)

static struct bt_uuid_128 rgb_srv_uuid = BT_UUID_INIT_128(RGB_SERVICE_VAL);
static struct bt_uuid_128 rgb_mode_chrc_uuid = BT_UUID_INIT_128(RGB_MODE_CHRC_VAL);
static struct bt_uuid_128 rgb_conf_chrc_uuid = BT_UUID_INIT_128(RGB_CONF_CHRC_VAL);
static struct bt_uuid_128 detector_state_chrc_uuid = BT_UUID_INIT_128(DETECTOR_STATE_CHRC_VAL);

static ssize_t read_mode(struct bt_conn *conn, const struct bt_gatt_attr *attr,
						 void *buf, uint16_t len, uint16_t offset)
{
	enum hikari_light_mode mode = hikari_light_mode_get();
	printk("Reading light mode: %d\n", (int)mode);

	return bt_gatt_attr_read(conn, attr, buf, len, offset, (uint8_t *)&mode, sizeof(uint8_t));
}

static ssize_t write_mode(struct bt_conn *conn, const struct bt_gatt_attr *attr,
						  const void *buf, uint16_t len, uint16_t offset, uint8_t flags)
{
	if (offset + len > sizeof(uint8_t)) {
		return BT_GATT_ERR(BT_ATT_ERR_INVALID_OFFSET);
	}

	enum hikari_light_mode mode = ((uint8_t *)buf)[0];
	printk("Writing light mode: %d\n", (int)mode);
	hikari_light_mode_set(mode);

	return len;
}

static ssize_t read_conf(struct bt_conn *conn, const struct bt_gatt_attr *attr,
						 void *buf, uint16_t len, uint16_t offset)
{
	static bool report_bigger = true;

	const uint8_t *conf = (uint8_t *)attr->user_data;

	uint8_t conf_to_read;
	if (report_bigger) {
		conf_to_read = *conf + 1;
		report_bigger = false;
	} else {
		conf_to_read = *conf;
		report_bigger = true;
	}

	return bt_gatt_attr_read(conn, attr, buf, len, offset, (void *)(&conf_to_read), sizeof(uint8_t));
}

static ssize_t write_conf(struct bt_conn *conn, const struct bt_gatt_attr *attr,
						  const void *buf, uint16_t len, uint16_t offset, uint8_t flags)
{
	static uint8_t tweak_type;
	float tweak_value;
	uint8_t *byte_buf = (uint8_t *)buf;

	if (len == sizeof(uint8_t)) {
		memcpy(&tweak_type, &byte_buf[0], sizeof(uint8_t));
		printk("tweak type: %d\n", tweak_type);
		return len;
	} else if (len == sizeof(float)) {
		memcpy(&tweak_value, &byte_buf[0], sizeof(float));
		printk("tweak value: %f\n", (double)tweak_value);
	} else {
		return BT_GATT_ERR(BT_ATT_ERR_INVALID_OFFSET);
	}

	switch (tweak_type) {
	case 1:
		hikari_light_tweak_color(tweak_value);
		break;

	case 2:
		hikari_light_tweak_intensity(tweak_value);
		break;

	case 3:
		hikari_light_tweak_gain(tweak_value);
		break;

	case 4:
		hikari_light_tweak_speed(tweak_value);
		break;

	default:
		return BT_GATT_ERR(BT_ATT_ERR_NOT_SUPPORTED);
		break;
	}

	return len;
}

static ssize_t read_detector_state(struct bt_conn *conn, const struct bt_gatt_attr *attr,
								   void *buf, uint16_t len, uint16_t offset)
{
	static bool detecting = true;

	if (offset + len > sizeof(uint8_t)) {
		return BT_GATT_ERR(BT_ATT_ERR_INVALID_OFFSET);
	}

	detecting = !detecting;

	return bt_gatt_attr_read(conn, attr, buf, len, offset, (void *)(uint8_t *)detecting, sizeof(uint8_t));
}

static bool notify_detector_state = false;

static void detector_state_ccc_cfg_changed(const struct bt_gatt_attr *attr, uint16_t value)
{
	notify_detector_state = (value == BT_GATT_CCC_NOTIFY) ? 1 : 0;
}

static uint8_t conf_value = 21;
static uint8_t detector_state = 3;

BT_GATT_SERVICE_DEFINE(rgb_svc,
	BT_GATT_PRIMARY_SERVICE(&rgb_srv_uuid),
	BT_GATT_CHARACTERISTIC((const struct bt_uuid *)&rgb_mode_chrc_uuid,
						   BT_GATT_CHRC_READ | BT_GATT_CHRC_WRITE,
						   BT_GATT_PERM_READ | BT_GATT_PERM_WRITE,
						   read_mode, write_mode, NULL),
	BT_GATT_CHARACTERISTIC((const struct bt_uuid *)&rgb_conf_chrc_uuid,
						   BT_GATT_CHRC_READ | BT_GATT_CHRC_WRITE,
						   BT_GATT_PERM_READ | BT_GATT_PERM_WRITE,
						   read_conf, write_conf, &conf_value),
	BT_GATT_CHARACTERISTIC((const struct bt_uuid *)&detector_state_chrc_uuid,
						   BT_GATT_CHRC_READ | BT_GATT_CHRC_NOTIFY,
						   BT_GATT_PERM_READ,
						   read_detector_state, NULL, &detector_state),
	BT_GATT_CCC(detector_state_ccc_cfg_changed,
				BT_GATT_PERM_READ | BT_GATT_PERM_WRITE)
);

static void connected(struct bt_conn *conn, uint8_t err)
{
	if (err) {
		printk("Connection failed (err 0x%02x)", err);
	} else {
		printk("Connected\n");
	}
}

static void disconnected(struct bt_conn *conn, uint8_t reason)
{
	printk("Disconnected (reason 0x%02x)\n", reason);
}

BT_CONN_CB_DEFINE(conn_callbacks) = {
	.connected = connected,
	.disconnected = disconnected,
};

static const struct bt_data adv[] = {
	BT_DATA_BYTES(BT_DATA_FLAGS, (BT_LE_AD_GENERAL | BT_LE_AD_NO_BREDR)),
	BT_DATA_BYTES(BT_DATA_UUID128_ALL, RGB_SERVICE_VAL),
};

void mtu_updated(struct bt_conn *conn, uint16_t tx, uint16_t rx)
{
	printk("Updated MTU: TX: %d RX: %d bytes\n", tx, rx);
}

static struct bt_gatt_cb gatt_callbacks = {
	.att_mtu_updated = mtu_updated,
};

void ble_start(void)
{
	int err;

	err = bt_enable(NULL);
	if (err) {
		printk("Bluetooth init failed, err %d\n", err);
		return;
	}
	printk("Bluetooth successfully initialized\n");

	err = bt_le_adv_start(
		BT_LE_ADV_PARAM(BT_LE_ADV_OPT_CONNECTABLE, BT_GAP_ADV_FAST_INT_MIN_2,
				BT_GAP_ADV_FAST_INT_MAX_2, NULL),
		adv, ARRAY_SIZE(adv), NULL, 0);
	if (err) {
		printk("Advertising failed to start, err %d\n", err);
		return;
	}
	printk("Advertising successfully started\n");

	bt_gatt_cb_register(&gatt_callbacks);
}
```

## src/light_resource.c
```c
#include <string.h>

#include <zephyr/kernel.h>

#include "adrledrgb.h"
#include "light_resource.h"

static sys_dlist_t resources;
static bool is_initialized = false;

#define LIGHT_RESOURCE_UPDATE_PERIOD_MS 25

/*==============================[Private methods]=============================*/
static bool is_overlapping(uint8_t *p1, size_t l1, uint8_t *p2, size_t l2)
{
	bool is_separate = (p2 >= p1 + l1) || (p1 >= p2 + l2);

	return !is_separate;
}

static bool register_resource(char *id, uint8_t *data, size_t data_size)
{
	sys_dnode_t *elem;
	struct light_resource *res_elem;
	int id_already_exist;
	bool data_overlapping;

	SYS_DLIST_FOR_EACH_NODE(&resources, elem) {
		res_elem = CONTAINER_OF(elem, struct light_resource, root);

		id_already_exist = !strcmp(res_elem->id, id);
		data_overlapping = is_overlapping(data, data_size, res_elem->data, res_elem->data_size);
		if (id_already_exist || data_overlapping) {
			return false;
		}
	}

	struct light_resource *new_res = k_malloc(sizeof(struct light_resource));
	if (new_res == NULL) {
		return false;
	}

	new_res->id = id;
	new_res->data = data;
	new_res->data_size = data_size;
	new_res->used = false;
	sys_dlist_append(&resources, &new_res->root);
	return true;
}

/*==============================[Setup resources]=============================*/
#define CHAIN_POMMEL_NUM 2
#define CHAIN_POMMEL_PIN 14 /* D6 */
#define CHAIN_POMMEL_PORT 1
RGB_CHAIN_DEF(chain_P, CHAIN_POMMEL_NUM, CHAIN_POMMEL_PIN, CHAIN_POMMEL_PORT, true);

#define CHAIN_CORE_NUM 6
#define CHAIN_CORE_PIN 11 /* D2 */
#define CHAIN_CORE_PORT 1
RGB_CHAIN_DEF(chain_C, CHAIN_CORE_NUM, CHAIN_CORE_PIN, CHAIN_CORE_PORT, true);

#define CHAIN_SQUARE_NUM 4
#define CHAIN_SQUARE_PIN 23 /* D7 */
#define CHAIN_SQUARE_PORT 0
RGB_CHAIN_DEF(chain_S, CHAIN_SQUARE_NUM, CHAIN_SQUARE_PIN, CHAIN_SQUARE_PORT, true);

#define CHAIN_INNER_BLADE_NUM 8
#define CHAIN_INNER_BLADE_PIN 27 /* D9 */
#define CHAIN_INNER_BLADE_PORT 0
RGB_CHAIN_DEF(chain_IB, CHAIN_INNER_BLADE_NUM, CHAIN_INNER_BLADE_PIN, CHAIN_INNER_BLADE_PORT, true);

#define CHAIN_LEFT_BLADE_NUM 14
#define CHAIN_LEFT_BLADE_PIN 2 /* D10 */
#define CHAIN_LEFT_BLADE_PORT 1
RGB_CHAIN_DEF(chain_LB, CHAIN_LEFT_BLADE_NUM, CHAIN_LEFT_BLADE_PIN, CHAIN_LEFT_BLADE_PORT, true);

#define CHAIN_RIGHT_BLADE_NUM 14
#define CHAIN_RIGHT_BLADE_PIN 13 /* D5 */
#define CHAIN_RIGHT_BLADE_PORT 1
RGB_CHAIN_DEF(chain_RB, CHAIN_RIGHT_BLADE_NUM, CHAIN_RIGHT_BLADE_PIN, CHAIN_RIGHT_BLADE_PORT, true);

#define CHAIN_LEFT_GUARD_NUM 4
#define CHAIN_LEFT_GUARD_PIN 21 /* D8 */
#define CHAIN_LEFT_GUARD_PORT 0
RGB_CHAIN_DEF(chain_LG, CHAIN_LEFT_GUARD_NUM, CHAIN_LEFT_GUARD_PIN, CHAIN_LEFT_GUARD_PORT, true);

#define CHAIN_RIGHT_GUARD_NUM 4
#define CHAIN_RIGHT_GUARD_PIN 15 /* D4 */
#define CHAIN_RIGHT_GUARD_PORT 1
RGB_CHAIN_DEF(chain_RG, CHAIN_RIGHT_GUARD_NUM, CHAIN_RIGHT_GUARD_PIN, CHAIN_RIGHT_GUARD_PORT, true);

#define CHAIN_LEFT_SPIKE_NUM 3
#define CHAIN_LEFT_SPIKE_PIN 12 /* D3 */
#define CHAIN_LEFT_SPIKE_PORT 1
RGB_CHAIN_DEF(chain_LS, CHAIN_LEFT_SPIKE_NUM, CHAIN_LEFT_SPIKE_PIN, CHAIN_LEFT_SPIKE_PORT, true);

#define CHAIN_RIGHT_SPIKE_NUM 3
#define CHAIN_RIGHT_SPIKE_PIN 1 /* D11 */
#define CHAIN_RIGHT_SPIKE_PORT 1
RGB_CHAIN_DEF(chain_RS, CHAIN_RIGHT_SPIKE_NUM, CHAIN_RIGHT_SPIKE_PIN, CHAIN_RIGHT_SPIKE_PORT, true);

rgb_chain_t *chains[10] = {&chain_P, &chain_C, &chain_S, &chain_IB, &chain_LB, &chain_RB,
						  &chain_LG, &chain_RG, &chain_LS, &chain_RS};

#define INIT_COLOR(_chain, _num, _red, _green, _blue) \
    for (uint32_t i = 0; i < _num; i++) {             \
		_chain.rgb_values[i].red = _red;              \
		_chain.rgb_values[i].green = _green;          \
		_chain.rgb_values[i].blue = _blue;            \
	}

#define REGISTER_RGB(_name, _chain, _idx)                                                  \
	if (!register_resource(_name, (uint8_t *)&(_chain.rgb_values[_idx]), sizeof(rgb_t))) { \
		k_oops();                                                                          \
	}

static void setup_light_resources(void)
{
	int ret;

	for (uint32_t i = 0; i < sizeof(chains)/sizeof(rgb_chain_t *); i++) {
		ret = adrledrgb_init(chains[i]);
		if (ret < 0) {
			k_oops();
		}
	}

	INIT_COLOR(chain_P, CHAIN_POMMEL_NUM, 20, 20, 20);
	INIT_COLOR(chain_C, CHAIN_CORE_NUM, 20, 20, 20);
	INIT_COLOR(chain_S, CHAIN_SQUARE_NUM, 20, 20, 20);
	INIT_COLOR(chain_IB, CHAIN_INNER_BLADE_NUM, 20, 20, 20);
	INIT_COLOR(chain_LB, CHAIN_LEFT_BLADE_NUM, 20, 20, 20);
	INIT_COLOR(chain_RB, CHAIN_RIGHT_BLADE_NUM, 20, 20, 20);
	INIT_COLOR(chain_LG, CHAIN_LEFT_GUARD_NUM, 20, 20, 20);
	INIT_COLOR(chain_RG, CHAIN_RIGHT_GUARD_NUM, 20, 20, 20);
	INIT_COLOR(chain_LS, CHAIN_LEFT_SPIKE_NUM, 20, 20, 20);
	INIT_COLOR(chain_RS, CHAIN_RIGHT_SPIKE_NUM, 20, 20, 20);

	for (uint32_t i = 0; i < sizeof(chains)/sizeof(rgb_chain_t *); i++) {
		do {
			ret = adrledrgb_update_leds(chains[i]);
			if (ret) {
				k_msleep(1);
			}
		} while (ret != 0);
	}

	REGISTER_RGB("pommel_f", chain_P, 0);
	REGISTER_RGB("pommel_b", chain_P, 1);

	REGISTER_RGB("core_f1", chain_C, 0);
	REGISTER_RGB("core_f2", chain_C, 1);
	REGISTER_RGB("core_f3", chain_C, 2);
	REGISTER_RGB("core_b1", chain_C, 3);
	REGISTER_RGB("core_b2", chain_C, 4);
	REGISTER_RGB("core_b3", chain_C, 5);

	REGISTER_RGB("square_f1", chain_S, 0);
	REGISTER_RGB("square_f2", chain_S, 1);
	REGISTER_RGB("square_b2", chain_S, 2);
	REGISTER_RGB("square_b1", chain_S, 3);

	REGISTER_RGB("midstar_f1", chain_IB, 0);
	REGISTER_RGB("midstar_f2", chain_IB, 1);
	REGISTER_RGB("midstar_f3", chain_IB, 2);
	REGISTER_RGB("midstar_b1", chain_IB, 3);
	REGISTER_RGB("midstar_b2", chain_IB, 4);
	REGISTER_RGB("midstar_b3", chain_IB, 5);
	REGISTER_RGB("tipstar_l", chain_IB, 6);
	REGISTER_RGB("tipstar_r", chain_IB, 7);

	REGISTER_RGB("Lblade_b1", chain_LB, 0);
	REGISTER_RGB("Lblade_b2", chain_LB, 1);
	REGISTER_RGB("Lblade_m1", chain_LB, 2);
	REGISTER_RGB("Lblade_m2", chain_LB, 3);
	REGISTER_RGB("Lblade_t1", chain_LB, 4);
	REGISTER_RGB("Lblade_t2", chain_LB, 5);
	REGISTER_RGB("Ltriangle_f4", chain_LB, 6);
	REGISTER_RGB("Ltriangle_f3", chain_LB, 7);
	REGISTER_RGB("Ltriangle_f2", chain_LB, 8);
	REGISTER_RGB("Ltriangle_f1", chain_LB, 9);
	REGISTER_RGB("Ltriangle_b1", chain_LB, 10);
	REGISTER_RGB("Ltriangle_b2", chain_LB, 11);
	REGISTER_RGB("Ltriangle_b3", chain_LB, 12);
	REGISTER_RGB("Ltriangle_b4", chain_LB, 13);

	REGISTER_RGB("Rblade_b1", chain_RB, 0);
	REGISTER_RGB("Rblade_b2", chain_RB, 1);
	REGISTER_RGB("Rblade_m1", chain_RB, 2);
	REGISTER_RGB("Rblade_m2", chain_RB, 3);
	REGISTER_RGB("Rblade_t1", chain_RB, 4);
	REGISTER_RGB("Rblade_t2", chain_RB, 5);
	REGISTER_RGB("Rtriangle_f4", chain_RB, 6);
	REGISTER_RGB("Rtriangle_f3", chain_RB, 7);
	REGISTER_RGB("Rtriangle_f2", chain_RB, 8);
	REGISTER_RGB("Rtriangle_f1", chain_RB, 9);
	REGISTER_RGB("Rtriangle_b1", chain_RB, 10);
	REGISTER_RGB("Rtriangle_b2", chain_RB, 11);
	REGISTER_RGB("Rtriangle_b3", chain_RB, 12);
	REGISTER_RGB("Rtriangle_b4", chain_RB, 13);


	REGISTER_RGB("Lguard_1", chain_LG, 0);
	REGISTER_RGB("Lguard_2", chain_LG, 1);
	REGISTER_RGB("Lguard_3", chain_LG, 2);
	REGISTER_RGB("Lguard_4", chain_LG, 3);

	REGISTER_RGB("Rguard_1", chain_RG, 0);
	REGISTER_RGB("Rguard_2", chain_RG, 1);
	REGISTER_RGB("Rguard_3", chain_RG, 2);
	REGISTER_RGB("Rguard_4", chain_RG, 3);

	REGISTER_RGB("Lspike_t", chain_LS, 0);
	REGISTER_RGB("Lspike_b", chain_LS, 1);
	REGISTER_RGB("Lspike", chain_LS, 2);

	REGISTER_RGB("Rspike_t", chain_RS, 0);
	REGISTER_RGB("Rspike_b", chain_RS, 1);
	REGISTER_RGB("Rspike", chain_RS, 2);
}

/*==============================[Light Update Thread]========================*/
K_SEM_DEFINE(light_init_sem, 0, 1);

#define LIGHT_UPDATE_THREAD_STACK_SIZE 512
#define LIGHT_UPDATE_THREAD_PRIORITY 5
#define LIGHT_UPDATE_THREAD_START_DELAY_MS 500

static void light_update_loop(void *p1, void *p2, void *p3)
{
	int ret;

	k_sem_take(&light_init_sem, K_FOREVER);

	while (1) {

		for (uint32_t i = 0; i < sizeof(chains)/sizeof(rgb_chain_t *); i++) {
			do {
				ret = adrledrgb_update_leds(chains[i]);
				if (ret) {
					k_msleep(1);
				}
			} while (ret != 0);
		}

		k_sleep(K_MSEC(LIGHT_RESOURCE_UPDATE_PERIOD_MS));
	}
}

K_THREAD_DEFINE(light_update_thread, LIGHT_UPDATE_THREAD_STACK_SIZE,
				light_update_loop, NULL, NULL, NULL,
				LIGHT_UPDATE_THREAD_PRIORITY, 0,
				LIGHT_UPDATE_THREAD_START_DELAY_MS);

/*==============================[Public methods]==============================*/
void light_resource_init(void)
{
	if (is_initialized) {
		return;
	}
	is_initialized = true;

	sys_dlist_init(&resources);

	setup_light_resources();

	k_sem_give(&light_init_sem);
}

light_res_err_t light_resource_use(char *id, struct light_resource **res)
{
	sys_dnode_t *elem;
	struct light_resource *res_elem;
	bool id_wrong;

	SYS_DLIST_FOR_EACH_NODE(&resources, elem) {
		res_elem = CONTAINER_OF(elem, struct light_resource, root);

		id_wrong = strcmp(res_elem->id, id);
		if (id_wrong) {
			continue;
		}

		if (res_elem->used) {
			*res = NULL;
			return LIGHT_RESOURCE_ALLREADY_USED;
		} else {
			res_elem->used = true;
			*res = res_elem;
			return LIGHT_RESOURCE_SUCCESS;
		}
	}

	*res = NULL;
	return LIGHT_RESOURCE_NOT_FOUND;
}

light_res_err_t light_resource_return(struct light_resource *res)
{
	sys_dnode_t *elem;
	struct light_resource *res_elem;

	SYS_DLIST_FOR_EACH_NODE(&resources, elem) {
		res_elem = CONTAINER_OF(elem, struct light_resource, root);

		if (res_elem != res) {
			continue;
		}

		res->used = false;
		return LIGHT_RESOURCE_SUCCESS;
	}

	return LIGHT_RESOURCE_NOT_FOUND;
}

/*============================================================================*/
```
