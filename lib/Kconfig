## lib/Kconfig
```kconfig
menu "Hikari Libraries"

rsource "adrledrgb/Kconfig"
rsource "hsm/Kconfig"
rsource "rbuf/Kconfig"

endmenu
```

## lib/hsm/Kconfig
```kconfig
config HSM
	bool "Hierarcial State Machine"

if HSM

config HSM_MAX_NEST_DEPTH
	int "Max nesting depth"
	default 5

endif # HSM
```

## lib/rbuf/Kconfig
```kconfig
menuconfig RBUF
	bool "Ring buffer library"
	help
	  Enable ring buffer library.

if RBUF

config RBUF_MAGIC
	bool "Instance sanitization magic"
	help
	  Add a magic word to the ring buffer structure.
	  This magic word is checked on rbuf function entries to decern
	  if the instance passed is really an rbuf instance.

config RBUF_ERROR_STRING
	bool "Ring buffer error to string"
	help
	  Enable the error to string conversion in function rbuf_strerr().
	  When this is enabled the rbuf_strerr() function can be used for
	  pretty printing the error.

endif # RBUF
```

## tests/bit_base/Kconfig
```kconfig
menu "Local sourcing"

source "$(ZEPHYR_NRF_MODULE_DIR)/lib/nrf_modem_lib/Kconfig.modemlib"

endmenu

source "Kconfig.zephyr"
```

## tests/cms/testcase.yaml
```yaml
tests:
  basic.cms:
    platform_allow:
      - arduino_nano_33_ble
    integration_platforms:
      - arduino_nano_33_ble
    tags:
      - cms
```

## tests/hsm/testcase.yaml
```yaml
tests:
  lib.hsm:
    platform_allow:
      - native_sim
    integration_platforms:
      - native_sim
    tags:
      - hsm
```

## tests/rbuf/testcase.yaml
```yaml
common:
  tags: rbuf

tests:
  lib.rbuf.no_magic:
    platform_allow:
      - native_sim
    integration_platforms:
      - native_sim
    extra_configs:
      - CONFIG_RBUF_MAGIC=n

  lib.rbuf.magic:
    platform_allow:
      - native_sim
    integration_platforms:
      - native_sim
    extra_configs:
      - CONFIG_RBUF_MAGIC=y
```

## tests/refctr/testcase.yaml
```yaml
tests:
  lib.refctr_test:
    platform_allow: native_posix
    integration_platforms:
      - native_posix
    tags: refctr
```

## tests/slab/testcase.yaml
```yaml
tests:
  lib.slab:
    platform_allow:
      - native_sim
    integration_platforms:
      - native_sim
    tags:
      - slab
```

## tests/slab_base/testcase.yaml
```yaml
tests:
  lib.node_base:
    platform_allow: native_posix
    integration_platforms:
      - native_posix
    tags: node_base
```

## tests/slab_delay/testcase.yaml
```yaml
tests:
  lib.slab_delay_test:
    platform_allow: native_posix
    integration_platforms:
      - native_posix
    tags: slab_delay
```

## tests/slab_glower/unity/testcase.yaml
```yaml
tests:
  lib.slab_glower:
    platform_allow:
      - native_sim
    integration_platforms:
      - native_sim
    tags:
      - slab_glower
```

## tests/slab_led/testcase.yaml
```yaml
tests:
  lib.slab_led:
    platform_allow:
      - native_sim
    integration_platforms:
      - native_sim
    tags:
      - slab_led
```

## west.yml
```yaml
manifest:
  remotes:
    - name: nrfconnect
      url-base: https://github.com/nrfconnect

  projects:
    - name: nrf
      repo-path: sdk-nrf
      remote: nrfconnect
      revision: v2.9.0
      import: true

  self:
    path: hikari
```
