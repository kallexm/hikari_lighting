## CMakeLists.txt
```
cmake_minimum_required(VERSION 3.20.0)

find_package(Zephyr REQUIRED HINTS $ENV{ZEPHYR_BASE})
project(cms)

target_sources(app PRIVATE src/main.c)
```

## prj.conf
```kconfig
#CONFIG_ZTEST=y
#CONFIG_ZTEST_NEW_API=y

CONFIG_HEAP_MEM_POOL_SIZE=2048

CONFIG_USB_DEVICE_VID=0x2FE3
CONFIG_USB_DEVICE_PID=0x0100

CONFIG_USB_DEVICE_STACK=y
CONFIG_USB_DEVICE_PRODUCT="Com system testing"
CONFIG_SERIAL=y
CONFIG_CONSOLE=y
CONFIG_UART_CONSOLE=y
CONFIG_UART_LINE_CTRL=y
```

## app.overlay
```dts
/ {
        chosen {
                zephyr,console = &cdc_acm_uart0;
        };
};

&zephyr_udc0 {
        cdc_acm_uart0: cdc_acm_uart0 {
                compatible = "zephyr,cdc-acm-uart";
                label = "CDC_ACM_0";
        };
};
```

## src/main.c
```c
#include <zephyr/zephyr.h>
#include <sys/printk.h>
#include <usb/usb_device.h>
#include <drivers/uart.h>
#include <drivers/gpio.h>

#define SLEEP_TIME_MS 500

static const struct gpio_dt_spec led = GPIO_DT_SPEC_GET(DT_ALIAS(led0), gpios);

static const struct device *usb_uart_dev = DEVICE_DT_GET(DT_CHOSEN(zephyr_console));

static void setup_debug_led(void)
{
	(void)device_is_ready(led.port);
	(void)gpio_pin_configure_dt(&led, GPIO_OUTPUT_ACTIVE);
}

static void wait_for_uart_attach(void)
{
	uint32_t dtr = 0;
	uint32_t timeout = 20;

	/* Poll if the DTR flag was set.
	 * Blocks in the while loop until terminal is attached.
	 */
	while (!dtr && timeout > 0) {
		uart_line_ctrl_get(usb_uart_dev, UART_LINE_CTRL_DTR, &dtr);
		// Give CPU resources to low priority threads.
		k_msleep(100);
		--timeout;
		gpio_pin_toggle_dt(&led);
	}
}

#if 0
#include <ztest.h>

static void *cms_suite_setup(void)
{
	setup_debug_led();

	usb_enable(NULL);
	wait_for_uart_attach();

	return NULL;
}

static void cms_suite_teardown(void *fixture)
{
}

ZTEST_SUITE(cms_suite, NULL, cms_suite_setup, NULL, NULL, cms_suite_teardown);

ZTEST(cms_suite, test_basic)
{
	gpio_pin_set_dt(&led, 0);
	k_msleep(SLEEP_TIME_MS);
	gpio_pin_toggle_dt(&led);
	k_msleep(SLEEP_TIME_MS);
	gpio_pin_toggle_dt(&led);
	k_msleep(SLEEP_TIME_MS);
	gpio_pin_toggle_dt(&led);

	printk("Hello world!\n");
}
#endif

int main(void)
{
	setup_debug_led();

	usb_enable(NULL);

	wait_for_uart_attach();

	printk("Starting cms test\n");

	gpio_pin_set_dt(&led, 0);
	while (1) {
		gpio_pin_toggle_dt(&led);
		k_msleep(SLEEP_TIME_MS);
	}

	return 0;
}
```
