## CMakeLists.txt
```
cmake_minimum_required(VERSION 3.20.0)

find_package(Zephyr REQUIRED HINTS $ENV{ZEPHYR_BASE})
project(slab_glower_test)

# create mock
cmock_handle(${HIKARI_DIR}/include/slab.h)
cmock_handle(${HIKARI_DIR}/include/slab_event.h)
cmock_handle(${HIKARI_DIR}/lib/slab/events/slab_event_hsv.h)
cmock_handle(${HIKARI_DIR}/lib/slab/events/slab_event_tick.h)
cmock_handle(${HIKARI_DIR}/include/glow_func.h)
#cmock_handle(${ZEPHYR_BASE}/include/zephyr/random/rand32.h)

# generate runner for the test
test_runner_generate(src/slab_glower_test.c)

# add test file
target_sources(app PRIVATE src/slab_glower_test.c)

# add unit under test
#target_sources(app PRIVATE ${HIKARI_DIR}/lib/slab/slab_glower.c)

# include paths
#target_include_directories(app PRIVATE ${HIKARI_DIR}/include)
```

## prj.conf
```kconfig
CONFIG_UNITY=y
CONFIG_ASSERT=y

# Enable use of dynamic memory allocation (k_malloc)
CONFIG_HEAP_MEM_POOL_SIZE=1024

# Enable random number function
CONFIG_ENTROPY_GENERATOR=y
#CONFIG_ENTROPY_DEVICE_RANDOM_GENERATOR=y
CONFIG_XOSHIRO_RANDOM_GENERATOR=y

CONFIG_FPU=y
```

## src/slab_glower_test.c
```c
#include <unity.h>

#include "slabs/slab_glower.h"
#include "mock_slab.h"
#include "mock_slab_event.h"
#include "mock_slab_event_hsv.h"
#include "mock_slab_event_tick.h"
#include "mock_glow_func.h"
#include "zephyr/random/rand32.h"

extern int unity_main(void);

void setUp(void)
{
	mock_slab_Init();
	mock_slab_event_Init();
}

void tearDown(void)
{
	mock_slab_Verify();
	mock_slab_event_Verify();
}

/* Suite teardown shall finalize with mandatory call to generic_suiteTearDown. */
extern int generic_suiteTearDown(int num_failures);

int test_suiteTearDown(int num_failures)
{
	return generic_suiteTearDown(num_failures);
}

/*==============================[Helpers]=====================================*/


/*==============================[Tests]=======================================*/
void test_slab_glower_create(void)
{
	struct slab *s;
	struct slab_glower *sg;
	struct slab_glower_config glower_config = {
		.hue = 152, .sat = 0.5,
		.val = { .a = 0.1, .b = 1, .ym = 0.5, .yd = 0.5 }
	};
	struct glow_func gf = { .conf = glower_config.val, .y1 = 1, .t1 = 0 };

	__wrap_glow_func_create_ExpectAndReturn(&glower_config.val, &gf);
	s = slab_glower_create(&glower_config);
	sg = (struct slab_glower *)s;
	TEST_ASSERT_EQUAL(152, sg->data.h);
	TEST_ASSERT_EQUAL(0.5, sg->data.s);
	TEST_ASSERT_EQUAL(0, sg->data.v);

	__wrap_glow_func_destroy_Expect(&gf);
	slab_glower_destroy(s);
}

void test_slab_glower_stim_tick(void)
{
	struct slab *s;
	struct slab_glower *sg;
	struct slab_glower_config glower_config = {
		.hue = 152, .sat = 0.5,
		.val = { .a = 0.1, .b = 1, .ym = 0.5, .yd = 0.5 }
	};
	struct glow_func gf = { .conf = glower_config.val, .y1 = 1, .t1 = 0 };

	struct slab_event *evt;
	struct slab_event_tick dummy_evt;
	
	dummy_evt.id = SLAB_EVENT_TICK;
	dummy_evt.num_refs = 0;
	dummy_evt.time = 2765;
	evt = (struct slab_event *)&dummy_evt;

	struct slab_event *hsv_evt;
	struct slab_event_hsv dummy_hsv_evt;
	dummy_hsv_evt.id = SLAB_EVENT_HSV;
	hsv_evt = (struct slab_event *)&dummy_hsv_evt;

	__wrap_glow_func_create_ExpectAndReturn(&glower_config.val, &gf);
	s = slab_glower_create(&glower_config);
	sg = (struct slab_glower *)s;

	/* With a native_posix test CONFIG_FAKE_ENTROPY_NATIVE_POSIX is enabled
	 * leading to psudo-random variables with a given seed. Result is that
	 * the sys_rand32_get() function will return the same sequence of values.
	 * Therefore, we hardcode the expected random value (0.3554688) that
	 * the glow_func_process() function will be called with, since it will be
	 * the same every time.
	 */
	__wrap_glow_func_process_ExpectAndReturn(&gf, 2765, 0.3554688, 0.2);
	__wrap_slab_event_create_ExpectAndReturn(SLAB_EVENT_HSV, hsv_evt);
	__wrap_slab_stim_childs_Expect(s, hsv_evt);
	__wrap_slab_stim_childs_Expect(s, evt);
	slab_glower_stim(s, evt);
	TEST_ASSERT_EQUAL_UINT8(152, sg->data.h);
	TEST_ASSERT_EQUAL_UINT8(0.5, sg->data.s);
	TEST_ASSERT_EQUAL_UINT8(0.2, sg->data.v);

	__wrap_glow_func_destroy_Expect(&gf);
	slab_glower_destroy(s);
}

void test_slab_glower_stim_reset(void)
{
	return;
}

void test_slab_glower_stim_default(void)
{
	return;
}

/*============================================================================*/

extern int unity_main(void);

void main(void)
{
	(void)unity_main();
}
```
